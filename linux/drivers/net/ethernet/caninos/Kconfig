## linux/drivers/net/ethernet/caninos/Kconfig
```kconfig
config LABRADOR_ENET
        tristate "LABRADOR ethernet MAC on CANINOS devices"
        select PHYLIB
        help
	  Say Y or M here if you want to use the NXP ethernet MAC included on
	  some NXP LPC devices. You can safely enable this option for LPC32xx
	  SoC. Also available as a module.
```
